## sdkconfig.defaults
```kconfig
# Hexapod ESP32 Display — XIAO ESP32-C3 + SH1122 256x64 OLED
CONFIG_IDF_TARGET="esp32c3"

# Console + ESP_LOG over the C3's built-in USB Serial/JTAG port
# (replaces Arduino's ARDUINO_USB_CDC_ON_BOOT).
CONFIG_ESP_CONSOLE_USB_SERIAL_JTAG=y

# 1 kHz tick so the 1 ms delays in the render and UART RX loops are real
# milliseconds instead of rounding up to a 10 ms tick.
CONFIG_FREERTOS_HZ=1000

CONFIG_LOG_COLORS=y
```
